/*
 * Author: Ethan Epstein
 * Email: ethanepstein@utexas.edu
 * Date: Spring 2020
 * License: Public Domain
*/

#include "GripTest.h"

#define ANALOG_THRESHOLD 5

// Declaration for an SSD1306 display connected to I2C (SDA, SCL pins)
Adafruit_SSD1306 display(128, 64, &Wire, -1);

GripTest::GripTest(){

  display.begin(SSD1306_SWITCHCAPVCC, 0x3C);
  age = GripTest::inputAge(50);
  while(!GripTest::confirmAge(age)){
    age = GripTest::inputAge(age);
  }
  
  gender = GripTest::inputGender();
  while(!GripTest::confirmGender(gender)){
    gender = GripTest::inputGender();
  }
  
}

int GripTest::inputAge(int ageGuess){
  
  int16_t  x1, y1;
  uint16_t w, h;
  int newAge = ageGuess;
  
  display.clearDisplay();
  headerPrint("Enter Age:", 2);
  
  display.setTextSize(4);
  while(!digitalRead(OKAY)){} //debounce
  while(digitalRead(OKAY)){
    if(!digitalRead(UP) && newAge < 99){
      newAge++;
      delay(100);
    }
    if(!digitalRead(DOWN) && newAge > 18){
      newAge--;
      delay(100);
    }
    
    display.setCursor(0,20);
    display.getTextBounds("<" + String(newAge) + ">", 0, 20, &x1, &y1, &w, &h);
    display.fillRect(x1, y1, 2 * w, h, 0);
    display.print("<" + String(newAge) + ">");
    display.display();

  }
  
  return newAge;
}

bool GripTest::confirmAge(int ageToCheck){
  
  int16_t  x1, y1;
  uint16_t w, h;
  
  display.clearDisplay();
  headerPrint("Age = " + ageToCheck, 2);

  display.setTextSize(4);
  bool rightAge = true;
  String rightAgeString;
  
  while(!digitalRead(OKAY)){} //debounce
  while(digitalRead(OKAY)){
    if(!digitalRead(UP) || !digitalRead(DOWN)){
      rightAge = !rightAge;
      delay(300);
    }
    
    display.setCursor(0,20);
    
    if(rightAge){
      rightAgeString = "yes";
    }
    else{
      rightAgeString = "no";
    }
    
    display.setCursor(0,20);
    display.getTextBounds(rightAgeString, 0, 20, &x1, &y1, &w, &h);
    display.fillRect(x1, y1, 2 * w, h, 0);
    display.print(rightAgeString);
    display.display();

  }
  
  return rightAge;
}

int GripTest::inputGender(){
  
  int16_t  x1, y1;
  uint16_t w, h;
  Gender genderInput = MALE;
  
  display.clearDisplay();
  headerPrint("Gender: ", 2);
  
  display.setTextSize(2);
  while(!digitalRead(OKAY)){} //debounce
  while(digitalRead(OKAY)){
    if(!digitalRead(UP) || !digitalRead(DOWN)){
      switch(genderInput){
        case MALE: genderInput = FEMALE; break;
        case FEMALE: genderInput = MALE; break;
      }
      delay(300);
    }
    
    display.setCursor(0,20);
    display.getTextBounds("<" + GripTest::genderToString(genderInput) + ">", 0, 20, &x1, &y1, &w, &h);
    display.fillRect(x1, y1, 128, h, 0);
    display.print("<" + GripTest::genderToString(genderInput) + ">");
    display.display();

  }
  
  return genderInput;
}

bool GripTest::confirmGender(Gender genderToCheck){
  
  int16_t  x1, y1;
  uint16_t w, h;
  
  display.clearDisplay();
  headerPrint("Gender = " + genderToString(genderToCheck)[0], 2);

  display.setTextSize(4);
  bool rightGender = true;
  String rightGenderString;
  
  while(!digitalRead(OKAY)){} //debounce
  while(digitalRead(OKAY)){
    if(!digitalRead(UP) || !digitalRead(DOWN)){
      rightGender = !rightGender;
      delay(300);
    }
    
    display.setCursor(0,20);
    
    if(rightGender){
      rightGenderString = "yes";
    }
    else{
      rightGenderString = "no";
    }
    
    display.setCursor(0,20);
    display.getTextBounds(rightGenderString, 0, 20, &x1, &y1, &w, &h);
    display.fillRect(x1, y1, 2 * w, h, 0);
    display.print(rightGenderString);
    display.display();

  }
  
  return rightGender;
}

void GripTest::test(){
  display.clearDisplay();
  display.setTextColor(WHITE);
  display.setTextSize(2);
  display.setCursor(0,0);
  display.println("Begin Test");
  display.setTextSize(1);
  display.setCursor(0,20);
  display.print("Test will begin when grip is squeezed");
  display.display();
  
  while(analogRead(FORCE) < ANALOG_THRESHOLD) {} //Wait for first squeeze
  
  display.clearDisplay();
  display.setTextSize(2);
  display.setCursor(0,0);
  display.println("Testing");
  display.drawBitmap(0, 20, testImage, 128, 44, WHITE);
  display.display();
  display.startscrollright(0x00, 0x01);
  
  //Take 3 seconds of readings, spaced 0.25 seconds apart
  for(int i = 0; i < 12; i++){
    forceMeasurement[i] = analogRead(FORCE) / 220; // This formula should be callibrated to the device with known force inputs
    delay(250);
  }
}

void GripTest::displayResults(){
  
  double meanForce = 0;
  for(int i = 0; i < 12; i++){
    meanForce += forceMeasurement[i];
  }
  meanForce /= 12;
  
  int ageGroup = (age / 5) - 4;  // This variable is used with standardsM/F arrays to determine normal values
  if(ageGroup < 0){ // 18/19 year olds
    ageGroup = 0;
  }
  else if(ageGroup > 11){ // >80 years olds
    ageGroup = 11;
  }
  
  display.clearDisplay();
  headerPrint(String(meanForce) + " lbs", 2);

  display.setTextSize(1);
  
  switch(gender){
    case MALE:
      if(meanForce < standardsM[ageGroup][0]){
        display.print("BELOW normal range for " + String(age) + " year old males");
      }
      else{ // data is included to determine if in or above, but in clinical setting with requirements, this info is not useful to intended market
        display.print("IN or ABOVE normal range for " + String(age) + " year old males");
      }
      break;
    case FEMALE:
      if(meanForce < standardsW[ageGroup][0]){
        display.print("BELOW normal range for " + String(age) + " year old females");
      }
      else{
        display.print("IN or ABOVE normal range for " + String(age) + " year old females");
      }
      break;
  }

  display.display();
  
  while(!digitalRead(UP) || !digitalRead(DOWN) || !digitalRead(OKAY)){}
  
  display.clearDisplay();
  
}

static void GripTest::headerPrint(String string, int size){
  display.setTextColor(WHITE);
  display.setTextSize(size);
  display.setCursor(0,0);
  display.println(string);
  display.display();
}